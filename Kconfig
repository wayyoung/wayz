## boards/nsing/n32g430f8_evb/Kconfig.defconfig
```kconfig
# SPDX-License-Identifier: Apache-2.0

if BOARD_N32G430F8_EVB

config BOARD
	default "N32G430F8_EVB"

endif
```

## boards/nsing/n32g430f8_evb/Kconfig.n32g430f8_evb
```kconfig
# SPDX-License-Identifier: Apache-2.0

config BOARD_N32G430F8_EVB
	select SOC_SERIES_N32G430
	select SOC_N32G430F8
```

## boards/nsing/n32g430f8_evb/board.yml
```yaml
# SPDX-License-Identifier: Apache-2.0

board:
  name: n32g430f8_evb
  vendor: taobao
  socs:
  - name: n32g430f8
```

## boards/nsing/n32g430f8_evb/n32g430f8_evb_defconfig
```kconfig
# SPDX-License-Identifier: Apache-2.0

CONFIG_SYS_CLOCK_HW_CYCLES_PER_SEC=128000000

# HSI_PLL
CONFIG_N32_SYSCLK_SRC=2
#CONFIG_N32_HSE_VALUE=24000000

CONFIG_CLOCK_CONTROL=y
CONFIG_RESET=y
CONFIG_PINCTRL=y
CONFIG_GPIO=y


# CONFIG_UART_ASYNC_API=y

# CONFIG_NVS=y
# CONFIG_SETTINGS=y

#CONFIG_FLASH=y
#CONFIG_STREAM_FLASH=y
#CONFIG_FLASH_MAP=y

# CONFIG_REBOOT=y
# CONFIG_INIT_STACKS=y
# CONFIG_MAIN_STACK_SIZE=16384
# CONFIG_ISR_STACK_SIZE=8192
# CONFIG_SYSTEM_WORKQUEUE_STACK_SIZE=2048
# CONFIG_SYSTEM_WORKQUEUE_PRIORITY=-1
```

## drivers/clock_control/Kconfig
```kconfig
# SPDX-License-Identifier: Apache-2.0

if CLOCK_CONTROL

config CLOCK_CONTROL_N32
	bool "CLOCK_CTRL Driver for N32 family of MCUs"
	default y
	depends on SOC_FAMILY_NSING_N32
	depends on DT_HAS_NSING_N32_RCC_ENABLED
	select N32_HAL_RCC
help
	  Enable CLOCK_CTRL driver for N32 MCUs

endif # CLOCK_CONTROL
```

## drivers/gpio/Kconfig
```kconfig
# SPDX-License-Identifier: Apache-2.0

if GPIO

config GPIO_N32
	bool "GPIO Driver for N32 family of MCUs"
    default "y"
	depends on SOC_FAMILY_NSING_N32
	select N32_HAL_GPIO
	help
	  Enable GPIO driver for N32 MCUs


endif # GPIO
```

## drivers/i2c/Kconfig
```kconfig
# SPDX-License-Identifier: Apache-2.0

if I2C

config I2C_N32
	bool "N32 I2C driver"
	default y
	select N32_HAL_I2C
	depends on DT_HAS_NSING_N32_I2C_ENABLED


config I2C_N32_INTERRUPT
	bool "N32 I2C Interrupt Support"
	default y
	depends on I2C_N32


config I2C_N32_COMBINED_INTERRUPT
	bool "N32 I2C combined interrupt support"
	depends on I2C_N32_INTERRUPT


config I2C_N32_BUS_RECOVERY
	bool "Bus recovery support"
	select I2C_BITBANG


endif
```

## drivers/interrupt_controller/Kconfig
```kconfig
# SPDX-License-Identifier: Apache-2.0

config EXTI_N32
	bool "N32 EXTI Controller"
	default y
	depends on DT_HAS_NSING_N32_EXTI_ENABLED
	depends on SOC_FAMILY_NSING_N32
```

## drivers/pinctrl/Kconfig
```kconfig
# SPDX-License-Identifier: Apache-2.0

if PINCTRL

config PINCTRL_N32
	bool "PINCTRL Driver for N32"
    default y
	depends on PINCTRL
	depends on SOC_FAMILY_NSING_N32

endif # PINCTRL
```

## drivers/reset/Kconfig
```kconfig
# SPDX-License-Identifier: Apache-2.0

if RESET

config PRST_N32
	bool "N32 Periph Reset Controller Driver"
	default y
	depends on DT_HAS_NSING_N32_PRST_ENABLED
	depends on SOC_FAMILY_NSING_N32
help
	  Enable RESET driver for N32 MCUs

endif # RESET
```

## drivers/serial/Kconfig
```kconfig
# SPDX-License-Identifier: Apache-2.0

if SERIAL

config UART_N32
	bool "N32 MCU serial driver"
	default y
	depends on SERIAL
	depends on DT_HAS_NSING_N32_UART_ENABLED
	select SERIAL_SUPPORT_ASYNC
	select SERIAL_HAS_DRIVER
	select SERIAL_SUPPORT_INTERRUPT
	select N32_HAL_USART



endif # SERIAL
```

## dts/bindings/clock/nsing,n32-prst.yaml
```yaml
# SPDX-License-Identifier: Apache-2.0

description: N32 periph reset controller

compatible: "nsing,n32-prst"

include: [reset-controller.yaml, base.yaml]

properties:
  "#reset-cells":
    const: 1

reset-cells:
  - id
```

## dts/bindings/clock/nsing,n32-rcc.yaml
```yaml
# SPDX-License-Identifier: Apache-2.0

description: N32 clock controller

compatible: "nsing,n32-rcc"

include: [clock-controller.yaml, base.yaml]

properties:
  reg:
    required: true

  "#clock-cells":
    const: 1

  clock-frequency:
    required: false
    type: int
    description: |
      default frequency in Hz for clock output

  ahb-prescaler:
    type: int
    required: false
    enum:
      - 1
      - 2
      - 4
      - 8
      - 16
      - 64
      - 128
      - 256
      - 512
    description: AHB prescaler.

  apb1-prescaler:
    type: int
    required: false
    enum:
      - 1
      - 2
      - 4
      - 8
      - 16

  apb2-prescaler:
    type: int
    required: false
    enum:
      - 1
      - 2
      - 4
      - 8
      - 16

clock-cells:
  - id
```

## dts/bindings/gpio/nsing,n32-gpio.yaml
```yaml
# SPDX-License-Identifier: Apache-2.0

description: N32 GPIO

compatible: "nsing,n32-gpio"

include: [gpio-controller.yaml, base.yaml]

properties:
  reg:
    required: true

  clocks:
    required: true

  "#gpio-cells":
    const: 2

gpio-cells:
  - pin
  - flags
```

## dts/bindings/i2c/nsing,n32-i2c.yaml
```yaml
# SPDX-License-Identifier: Apache-2.0

description: N32 I2C

compatible: "nsing,n32-i2c"

include: [i2c-controller.yaml, reset-device.yaml, pinctrl-device.yaml]

properties:
  reg:
    required: true

  interrupts:
    required: true

  resets:
    required: true

  clocks:
    required: true

  pinctrl-0:
    required: true

  pinctrl-names:
    required: true

  scl-gpios:
    type: phandle-array
    description: |
      GPIO to which the I2C SCL signal is routed. This is only needed for I2C bus recovery
      support.

  sda-gpios:
    type: phandle-array
    description: |
      GPIO to which the I2C SDA signal is routed. This is only needed for I2C bus recovery
      support.
```

## dts/bindings/pinctrl/nsing,n32-pinctrl.yaml
```yaml
# SPDX-License-Identifier: Apache-2.0

description: N32 pinctrl

compatible: "nsing,n32-pinctrl"

include: base.yaml

properties:
  pinmux-controller:
    type: boolean
    description: Indicates that this node is a pinmux controller.

  "#pinmux-cells":
    const: 2
    type: int

pinmux-cells:
  - config
  - func

child-binding:
  description: |
    N32 pin controller pin configuration state nodes.
  child-binding:
    description: |
      N32 pin controller pin configuration group.

    properties:
      pinmuxs:
        required: true
        type: phandle-array
        description: |
          An array of pinmux settings.

      remap:
        type: int
        default: 0
        description: |
          N32 pin remap setting.
```

## dts/bindings/serial/nsing,n32-uart.yaml
```yaml
# SPDX-License-Identifier: Apache-2.0

description: N32 UART

compatible: "nsing,n32-uart"

include: [uart-controller.yaml, pinctrl-device.yaml]

properties:
  reg:
    required: true

  interrupts:
    required: true
```

## hal_nsing/Kconfig
```kconfig
# SPDX-License-Identifier: Apache-2.0

config HAS_N32_HAL
	bool


if HAS_N32_HAL

config N32_HAL_ADC
	bool

config N32_HAL_BKP
	bool

config N32_HAL_CAN
	bool

config N32_HAL_CRC
	bool

config N32_HAL_DAC
	bool

config N32_HAL_DBG
	bool

config N32_HAL_DMA
	bool

config N32_HAL_DVP
	bool

config N32_HAL_EXTI
	bool

config N32_HAL_FLASH
	bool

config N32_HAL_GPIO
	bool

config N32_HAL_I2C
	bool

config N32_HAL_IWDG
	bool

config N32_HAL_PWR
	bool

config N32_HAL_QSPI
	bool

config N32_HAL_RCC
	bool

config N32_HAL_RTC
	bool

config N32_HAL_SD
	bool

config N32_HAL_SPI
	bool

config N32_HAL_TIM
	bool

config N32_HAL_USART
	bool

config N32_HAL_WWDG
	bool

config N32_HAL_USB_DC
	bool

endif # HAS_N32_HAL
```

## soc/nsing/n32g4/n32g430/Kconfig
```kconfig
# SPDX-License-Identifier: Apache-2.0

config SOC_FAMILY_NSING_N32
	select BUILD_OUTPUT_HEX
	select HAS_N32_HAL
```

## soc/nsing/n32g4/n32g430/Kconfig.soc
```kconfig
# SPDX-License-Identifier: Apache-2.0

config SOC_FAMILY_NSING_N32
	bool

config SOC_FAMILY
	default "nsing_n32" if SOC_FAMILY_NSING_N32

rsource "*/Kconfig.soc"
```

## soc/nsing/n32g4/n32g430/n32g430/Kconfig.defconfig.n32g430f8
```kconfig
# SPDX-License-Identifier: Apache-2.0

if SOC_N32G430F8

config SOC
	default "n32g430f8"


endif # SOC_N32G430F8
```

## soc/nsing/n32g4/n32g430/n32g430/Kconfig.defconfig.series
```kconfig
# SPDX-License-Identifier: Apache-2.0

if SOC_SERIES_N32G430

config SOC_SERIES
	default "n32g430"

config NUM_IRQS
	default 53

rsource "./Kconfig.defconfig.n32g430*"

endif # SOC_SERIES_N32G430
```

## soc/nsing/n32g4/n32g430/n32g430/Kconfig.soc
```kconfig
# SPDX-License-Identifier: Apache-2.0

config SOC_SERIES_N32G430
	bool "N32G430 Series MCU"
	select ARM
	select CPU_HAS_ARM_MPU
	select CPU_CORTEX_M4
	select CPU_HAS_FPU
	select CORTEX_M_SYSTICK
	select SOC_FAMILY_NSING_N32
	help
	  Enable support for N32G430 MCU series

config SOC_N32G430F8
	bool "N32G430F8"
	select SOC_SERIES_N32G430

config N32_HSE_VALUE
	int "N32_HSE_VALUE"
	default 8000000
	help
	    N32 HSE_VALUE

config N32_SYSCLK_SRC
	int "N32_SYSCLK_SRC"
	default 3
	help
	    SYSCLK_USE_HSI     0
		SYSCLK_USE_HSE     1
		SYSCLK_USE_HSI_PLL 2
		SYSCLK_USE_HSE_PLL 3
```

## west.yml
```yaml
# SPDX-License-Identifier: Apache-2.0

manifest:
  #self:
  #  west-commands: scripts/west-commands.yml

  remotes:
    - name: zephyr
      url-base: https://github.com/zephyrproject-rtos/

  projects:
    - name: zephyr
      remote: zephyr
      revision: main
      import:
        # By using name-allowlist we can clone only the modules that are
        # strictly needed by the application.
        name-allowlist:
          - cmsis            # required by the ARM port
          - cmsis_6          # required by the ARM port
          - mbedtls
          - zcbor
          # - tinycrypt
          - hal_stm32
          - hal_espressif
          - hal_gd32
  self:
    path: wayz
```
